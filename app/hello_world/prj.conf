## CMakeLists.txt
```
 ##############################################################################
 #                                                                            #
 # Copyright (C) 2025 Nils Bosbach                                            #
 # All Rights Reserved                                                        #
 #                                                                            #
 # This is work is licensed under the terms described in the LICENSE file     #
 # found in the root directory of this source tree.                           #
 #                                                                            #
 ##############################################################################

cmake_minimum_required(VERSION 3.20)

set(DTC_OVERLAY_FILE "${CMAKE_CURRENT_SOURCE_DIR}/boards/avp64.overlay")
find_package(Zephyr REQUIRED HINTS $ENV{ZEPHYR_BASE})

project(app VERSION 2026.01.05 LANGUAGES C)

target_sources(app PRIVATE
    ${CMAKE_CURRENT_SOURCE_DIR}/src/main.c
)

target_include_directories(app PRIVATE include)
```

## prj.conf
```kconfig
 ##############################################################################
 #                                                                            #
 # Copyright (C) 2025 Nils Bosbach                                            #
 # All Rights Reserved                                                        #
 #                                                                            #
 # This is work is licensed under the terms described in the LICENSE file     #
 # found in the root directory of this source tree.                           #
 #                                                                            #
 ##############################################################################

CONFIG_VCML_SIMDEV=y

CONFIG_LOG=y
CONFIG_LOG_DEFAULT_LEVEL=3
CONFIG_LOG_BACKEND_UART=y
CONFIG_LOG_BUFFER_SIZE=0
CONFIG_LOG_MODE_IMMEDIATE=y

CONFIG_KERNEL_VM_SIZE=0x80000000

CONFIG_MINIMAL_LIBC=y
CONFIG_MINIMAL_LIBC_OPTIMIZE_STRING_FOR_SIZE=n
```

## boards/avp64.overlay
```dts
/******************************************************************************
 *                                                                            *
 * Copyright (C) 2025 Nils Bosbach                                            *
 * All Rights Reserved                                                        *
 *                                                                            *
 * This is work is licensed under the terms described in the LICENSE file     *
 * found in the root directory of this source tree.                           *
 *                                                                            *
 ******************************************************************************/

/ {
	soc {
		simdev: vcml_simdev@10008000 {
			compatible = "vcml,simdev";
			reg = <0x10008000 0x1000>;
		};
    };
};
```

## src/main.c
```c
#include <string.h>
#include <zephyr/kernel.h>
#include <zephyr/logging/log.h>
#include <zephyr/logging/log_ctrl.h>

#include <app/drivers/vcml_simdev.h>

#define STACKSIZE 2048
#define PRIORITY  7

LOG_MODULE_REGISTER(main);

// devices
static const struct device* simdev = DEVICE_DT_GET(DT_NODELABEL(simdev));

int init() {
    if (!simdev) {
        LOG_ERR("simdev not found in device tree");
        return 1;
    }
    if (!device_is_ready(simdev)) {
        LOG_ERR("simdev not ready");
        return 1;
    }

    return 0;
}

int main() {
    int init_ret = init();
    if (init_ret != 0)
        return init_ret;

    LOG_INF("Hello World");
    LOG_INF("Stopping in 1s...");
    log_flush();
    k_sleep(K_MSEC(1000));

    vcml_simdev_stop(simdev);
    return 0;
}
```
