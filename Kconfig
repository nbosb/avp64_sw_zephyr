## Kconfig
```kconfig
 ##############################################################################
 #                                                                            #
 # Copyright (C) 2025 Nils Bosbach                                            #
 # All Rights Reserved                                                        #
 #                                                                            #
 # This is work is licensed under the terms described in the LICENSE file     #
 # found in the root directory of this source tree.                           #
 #                                                                            #
 ##############################################################################

rsource "drivers/Kconfig"
```

## boards/arm64/avp64/Kconfig.avp64
```kconfig
 ##############################################################################
 #                                                                            #
 # Copyright (C) 2025 Nils Bosbach                                            #
 # All Rights Reserved                                                        #
 #                                                                            #
 # This is work is licensed under the terms described in the LICENSE file     #
 # found in the root directory of this source tree.                           #
 #                                                                            #
 ##############################################################################

config BOARD_AVP64
    select SOC_AVP64
```

## boards/arm64/avp64/Kconfig.defconfig
```kconfig
 ##############################################################################
 #                                                                            #
 # Copyright (C) 2025 Nils Bosbach                                            #
 # All Rights Reserved                                                        #
 #                                                                            #
 # This is work is licensed under the terms described in the LICENSE file     #
 # found in the root directory of this source tree.                           #
 #                                                                            #
 ##############################################################################

if BOARD_AVP64

config BUILD_OUTPUT_BIN
	default y

endif # BOARD_AVP64
```

## boards/arm64/avp64/avp64_avp64_x1_defconfig
```kconfig
 ##############################################################################
 #                                                                            #
 # Copyright (C) 2025 Nils Bosbach                                            #
 # All Rights Reserved                                                        #
 #                                                                            #
 # This is work is licensed under the terms described in the LICENSE file     #
 # found in the root directory of this source tree.                           #
 #                                                                            #
 ##############################################################################

CONFIG_ARM_ARCH_TIMER=y

# Cache management
CONFIG_CACHE_MANAGEMENT=y

# Enable UART driver
CONFIG_SERIAL=y

# Enable console
CONFIG_CONSOLE=y
CONFIG_UART_CONSOLE=y

# Enable serial port
CONFIG_UART_PL011=y
CONFIG_UART_INTERRUPT_DRIVEN=y

# SMP-related
CONFIG_SMP=y
CONFIG_MP_MAX_NUM_CPUS=1
CONFIG_TIMEOUT_64BIT=y
```

## boards/arm64/avp64/board.yml
```yaml
 ##############################################################################
 #                                                                            #
 # Copyright (C) 2025 Nils Bosbach                                            #
 # All Rights Reserved                                                        #
 #                                                                            #
 # This is work is licensed under the terms described in the LICENSE file     #
 # found in the root directory of this source tree.                           #
 #                                                                            #
 ##############################################################################

board:
  name: avp64
  vendor: arm64
  socs:
  - name: avp64
    variants:
    - name: x1
    - name: x2
    - name: x4
    - name: x8
```

## drivers/Kconfig
```kconfig
 ##############################################################################
 #                                                                            #
 # Copyright (C) 2025 Nils Bosbach                                            #
 # All Rights Reserved                                                        #
 #                                                                            #
 # This is work is licensed under the terms described in the LICENSE file     #
 # found in the root directory of this source tree.                           #
 #                                                                            #
 ##############################################################################

menu "Drivers"
rsource "vcml_simdev/Kconfig"
endmenu
```

## drivers/vcml_simdev/Kconfig
```kconfig
 ##############################################################################
 #                                                                            #
 # Copyright (C) 2025 Nils Bosbach                                            #
 # All Rights Reserved                                                        #
 #                                                                            #
 # This is work is licensed under the terms described in the LICENSE file     #
 # found in the root directory of this source tree.                           #
 #                                                                            #
 ##############################################################################

menuconfig VCML_SIMDEV
	bool "vcml simdev"

if VCML_SIMDEV

module = VCML_SIMDEV
module-str = vcml_simdev
source "subsys/logging/Kconfig.template.log_config"

config VCML_SIMDEV_INIT_PRIORITY
	int "simdev init priority"
	default 90
	help
	  SIMDEV initialization priority.

endif # VCML_SIMDEV
```

## dts/bindings/vcml_simdev/vcml.simdev.yaml
```yaml
 ##############################################################################
 #                                                                            #
 # Copyright (C) 2025 Nils Bosbach                                            #
 # All Rights Reserved                                                        #
 #                                                                            #
 # This is work is licensed under the terms described in the LICENSE file     #
 # found in the root directory of this source tree.                           #
 #                                                                            #
 ##############################################################################

description: |
  Simulation-Control Device

compatible: "vcml,simdev"

include: base.yaml

properties:
  reg:
    required: true
```

## soc/arm64/avp64/Kconfig
```kconfig
 ##############################################################################
 #                                                                            #
 # Copyright (C) 2025 Nils Bosbach                                            #
 # All Rights Reserved                                                        #
 #                                                                            #
 # This is work is licensed under the terms described in the LICENSE file     #
 # found in the root directory of this source tree.                           #
 #                                                                            #
 ##############################################################################

config SOC_AVP64
	select ARM64
	select CPU_CORTEX_A
	select ARMV8_A
```

## soc/arm64/avp64/Kconfig.defconfig
```kconfig
 ##############################################################################
 #                                                                            #
 # Copyright (C) 2025 Nils Bosbach                                            #
 # All Rights Reserved                                                        #
 #                                                                            #
 # This is work is licensed under the terms described in the LICENSE file     #
 # found in the root directory of this source tree.                           #
 #                                                                            #
 ##############################################################################

if SOC_AVP64

config NUM_IRQS
	# must be >= the highest interrupt number used
	# - include the UART interrupts
	default 220

config SYS_CLOCK_HW_CYCLES_PER_SEC
	int
	default 1000000000

config SYS_CLOCK_TICKS_PER_SEC
    int
    default 100

endif # SOC_AVP64
```

## soc/arm64/avp64/Kconfig.soc
```kconfig
 ##############################################################################
 #                                                                            #
 # Copyright (C) 2025 Nils Bosbach                                            #
 # All Rights Reserved                                                        #
 #                                                                            #
 # This is work is licensed under the terms described in the LICENSE file     #
 # found in the root directory of this source tree.                           #
 #                                                                            #
 ##############################################################################

config SOC_AVP64
	bool

config SOC
	default "avp64" if SOC_AVP64
```

## west.yml
```yaml
 ##############################################################################
 #                                                                            #
 # Copyright (C) 2025 Nils Bosbach                                            #
 # All Rights Reserved                                                        #
 #                                                                            #
 # This is work is licensed under the terms described in the LICENSE file     #
 # found in the root directory of this source tree.                           #
 #                                                                            #
 ##############################################################################

manifest:
  self:
    path: app

  remotes:
    - name: zephyrproject-rtos
      url-base: https://github.com/zephyrproject-rtos

  projects:
    - name: zephyr
      remote: zephyrproject-rtos
      revision: v4.3.0
      import:
        name-allowlist:
          - zephyr
```
